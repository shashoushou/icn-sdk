## meta-icn-sdk/meta-fsl-imx/conf/layer.conf
```bitbake
# We have a conf and classes directory, add to BBPATH
BBPATH .= ":${LAYERDIR}"

# We have recipes-* directories, add to BBFILES
BBFILES += "${LAYERDIR}/recipes-*/*/*.bb \
            ${LAYERDIR}/recipes-*/*/*.bbappend"

BBFILE_COLLECTIONS += "meta-fsl-imx"
BBFILE_PATTERN_meta-fsl-imx = "^${LAYERDIR}/"
BBFILE_PRIORITY_meta-fsl-imx = "6"

LAYERDEPENDS_meta-fsl-imx = "core"
LAYERSERIES_COMPAT_meta-fsl-imx = "hardknott"
```

## meta-icn-sdk/meta-fsl-imx/conf/machine/test.conf
```bitbake
MACHINEOVERRIDES =. "imx-boot-container:mx8:mx8m:mx8mm:"

require conf/machine/include/imx-base.inc
require conf/machine/include/tune-cortexa53.inc

MACHINE_FEATURES += "pci wifi bluetooth bcm43455 bcm4356"

MACHINE_FEATURES:append:use-nxp-bsp = " optee jailhouse bcm4359"

KERNEL_DEVICETREE = " \
    freescale/imx8mm-j850.dtb \
"
KERNEL_DEVICETREE_append_use-nxp-bsp = " \
	freescale/imx8mm-j850.dtb-pcie-ep.dtb \
"

UBOOT_DTB_NAME = "${KERNEL_DEVICETREE_BASENAME}.dtb"

IMX_DEFAULT_BOOTLOADER_use-nxp-bsp = "u-boot-imx"
IMX_DEFAULT_BOOTLOADER_use-mainline-bsp = "u-boot-fslc"

UBOOT_SUFFIX = "bin"

UBOOT_CONFIG ??= "sd"
UBOOT_CONFIG[sd]       = "${UBOOT_CONFIG_BASENAME}_defconfig,sdcard"
UBOOT_CONFIG[emmc]       = "${UBOOT_CONFIG_BASENAME}_defconfig,sdcard"
UBOOT_CONFIG[mfgtool]  = "${UBOOT_CONFIG_BASENAME}_defconfig"

SPL_BINARY = "spl/u-boot-spl.bin"

ATF_PLATFORM = "imx8mm"
ATF_LOAD_ADDR = "0x920000"

# Extra firmware package name, that is required to build boot container for fslc bsp
IMX_EXTRA_FIRMWARE = "firmware-imx-8m"

IMXBOOT_TARGETS = "${@bb.utils.contains('UBOOT_CONFIG', 'fspi', '${IMXBOOT_TARGETS_BASENAME}_flexspi', '${IMXBOOT_TARGETS_BASENAME}', d)}"

IMX_BOOT_SOC_TARGET = "iMX8MM"

SERIAL_CONSOLES = "115200;ttymxc1"

LOADADDR = ""
UBOOT_SUFFIX = "bin"
UBOOT_MAKE_TARGET = "all"
IMX_BOOT_SEEK = "33"

OPTEE_BIN_EXT = "8mm"
TEE_LOAD_ADDR = "0xbe000000"

# Add additional firmware
MACHINE_FIRMWARE_append = " linux-firmware-ath10k"
#@TYPE: Machine
#@NAME: NXP i.MX 8M Mini EVK with LPDDR4
#@SOC: i.MX8MM
#@DESCRIPTION: Machine configuration for NXP i.MX 8M Mini Evaluation Kit with LPDDR4
#@MAINTAINER: Jun Zhu <junzhu@nxp.com>

require include/imx8mm-j800.inc

# The device tree name is implicit for LPDDR4, so can't use MACHINE here
#KERNEL_DEVICETREE_BASENAME = "imx8mm-j800"


UBOOT_CONFIG_BASENAME = "imx8mm_j850"
UBOOT_CONFIG[fspi] = "${UBOOT_CONFIG_BASENAME}_fspi_defconfig"

DDR_FIRMWARE_NAME = " \
	lpddr4_pmu_train_1d_imem.bin \
	lpddr4_pmu_train_1d_dmem.bin \
	lpddr4_pmu_train_2d_imem.bin \
	lpddr4_pmu_train_2d_dmem.bin \
"

IMXBOOT_TARGETS_BASENAME = "flash_evk"
# DEPRECATED: Machine is renamed, please use imx8mm-lpddr4-evk
MACHINEOVERRIDES =. "imx8mm-j850:"

# Include device trees for other boards for internal test
KERNEL_DEVICETREE += " \
    freescale/imx8mm-j850.dtb \
    freescale/imx8mm-j850-pcie-ep.dtb \
    freescale/imx8mm-j850-rm67191.dtb \
    freescale/imx8mm-j850-rm67199.dtb \
    freescale/imx8mm-j850-revb.dtb \
    freescale/imx8mm-j850-revb-rm67191.dtb \
    freescale/imx8mm-j850-revb-rm67199.dtb \
"
```

## meta-icn-sdk/meta-icn-sdk/conf/layer.conf
```bitbake
# We have a conf and classes directory, add to BBPATH
BBPATH .= ":${LAYERDIR}"

# We have recipes-* directories, add to BBFILES
BBFILES += "${LAYERDIR}/recipes-*/*/*.bb \
            ${LAYERDIR}/recipes-*/*/*.bbappend"

BBFILE_COLLECTIONS += "meta-icn-sdk"
BBFILE_PATTERN_meta-icn-sdk = "^${LAYERDIR}/"
BBFILE_PRIORITY_meta-icn-sdk = "6"

LAYERDEPENDS_meta-icn-sdk = "core"
LAYERSERIES_COMPAT_meta-icn-sdk = "hardknott"
```
